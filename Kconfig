## Kconfig
```kconfig
mainmenu "F4OS Configuration"

source arch/Kconfig

menu "Drivers"
source dev/Kconfig
endmenu

menu "Memory management"
source mm/Kconfig
endmenu

menu "Kernel"
source kernel/Kconfig
endmenu

config DEVICE_TREE
    string
    prompt "Device Tree Source File"
    ---help---
        Source device tree file to be built into the OS for runtime
        configuration.  This option should be a path to a device tree
        source file, relative to the root OS directory.
```

## arch/Kconfig
```kconfig
menu "Arch"

choice
    prompt "Architecture"
    default ARCH_ARMV7M

config ARCH_ARMV7M
    bool "armv7m"
    ---help---
        ARMv7-M microcontroller profile

config ARCH_ARMV7A
    bool "armv7a"
    ---help---
        ARMv7-A profile

endchoice

config ARCH
    string
    default "armv7m" if ARCH_ARMV7M
    default "armv7a" if ARCH_ARMV7A

if ARCH_ARMV7M
source arch/armv7m/Kconfig
endif

if ARCH_ARMV7A
source arch/armv7a/Kconfig
endif

endmenu
```

## arch/armv7a/Kconfig
```kconfig
config INIT_SVC_STACK_POINTER
    hex
    prompt "Initial SVC Stack Pointer"
    ---help---
        The SVC mode stack pointer is initialized to this value

config INIT_IRQ_STACK_POINTER
    hex
    prompt "Initial IRQ Stack Pointer"
    ---help---
        The IRQ mode stack pointer is initialized to this value

config INIT_FIQ_STACK_POINTER
    hex
    prompt "Initial FIQ Stack Pointer"
    ---help---
        The FIQ mode stack pointer is initialized to this value

config INIT_ABT_STACK_POINTER
    hex
    prompt "Initial ABT Stack Pointer"
    ---help---
        The ABT mode stack pointer is initialized to this value

config INIT_UND_STACK_POINTER
    hex
    prompt "Initial UND Stack Pointer"
    ---help---
        The UND mode stack pointer is initialized to this value

config COPY_DATA
    bool
    prompt "Copy .data section"
    default n if CHIP_AM335X
    ---help---
        If the .data section is not already in memory at system startup,
        it must be copied as part of the C runtime startup.

menu "Chip"
source arch/armv7a/chip/Kconfig
endmenu

menu "Memory layout"

config VECTOR_VMA_REGION
    string "VMA region for .vector section"
    default "flash"

config VECTOR_LMA_REGION
    string "LMA region for .vector section"
    default VECTOR_VMA_REGION

config KERNEL_VMA_REGION
    string "VMA region for .kernel section"
    default "flash"

config KERNEL_LMA_REGION
    string "LMA region for .kernel section"
    default KERNEL_VMA_REGION

config TEXT_VMA_REGION
    string "VMA region for .text section"
    default "flash"

config TEXT_LMA_REGION
    string "LMA region for .text section"
    default TEXT_VMA_REGION

config RODATA_VMA_REGION
    string "VMA region for .rodata section"
    default "flash"

config RODATA_LMA_REGION
    string "LMA region for .rodata section"
    default RODATA_VMA_REGION

config LINKER_ARRAY_VMA_REGION
    string "VMA region for .linker_array section"
    default "flash"

config LINKER_ARRAY_LMA_REGION
    string "LMA region for .linker_array section"
    default LINKER_ARRAY_VMA_REGION

config DTB_VMA_REGION
    string "VMA region for .dtb section"
    default "flash"

config DTB_LMA_REGION
    string "LMA region for .dtb section"
    default DTB_VMA_REGION

config DATA_VMA_REGION
    string "VMA region for .data section"
    default "ram"

config DATA_LMA_REGION
    string "LMA region for .data section"
    default "flash"

config BSS_VMA_REGION
    string "VMA region for .bss section"
    default "ram"

config BSS_LMA_REGION
    string "LMA region for .bss section"
    default "flash"

endmenu
```

## arch/armv7a/chip/Kconfig
```kconfig
# Chip selection configuration

choice
    prompt "Chip to target"
    default CHIP_AM335X

config CHIP_AM335X
    bool "am335x"
    ---help---
        TI Sitara series AM335x Cortex-A8

endchoice

config CHIP
    string
    default "am335x" if CHIP_AM335X

if CHIP_AM335X
source arch/armv7a/chip/am335x/Kconfig
endif
```

## arch/armv7a/chip/am335x/Kconfig
```kconfig
menu "Clocks"

config AM335X_REFERENCE_CLOCK
    int
    prompt "Reference clock speed (Hz)"
    default 24000000
    ---help---
        This is the reference clock (crystal) on the board.
        All clocks in the system are referenced from this clock.

config AM335X_DEFAULT_SYSTEM_CLOCK
    int
    prompt "Default system clock speed (MHz)"
    default 200
    ---help---
        This is the default clock speed of the core.  It may be
        modified by power management.

endmenu
```

## arch/armv7m/Kconfig
```kconfig
menu "Chip"
source arch/armv7m/chip/Kconfig
endmenu

menu "Memory layout"

config VECTOR_VMA_REGION
    string "VMA region for .vector section"
    default "flash"

config VECTOR_LMA_REGION
    string "LMA region for .vector section"
    default VECTOR_VMA_REGION

config KERNEL_VMA_REGION
    string "VMA region for .kernel section"
    default "flash"

config KERNEL_LMA_REGION
    string "LMA region for .kernel section"
    default KERNEL_VMA_REGION

config TEXT_VMA_REGION
    string "VMA region for .text section"
    default "flash"

config TEXT_LMA_REGION
    string "LMA region for .text section"
    default TEXT_VMA_REGION

config RODATA_VMA_REGION
    string "VMA region for .rodata section"
    default "flash"

config RODATA_LMA_REGION
    string "LMA region for .rodata section"
    default RODATA_VMA_REGION

config LINKER_ARRAY_VMA_REGION
    string "VMA region for .linker_array section"
    default "flash"

config LINKER_ARRAY_LMA_REGION
    string "LMA region for .linker_array section"
    default LINKER_ARRAY_VMA_REGION

config DTB_VMA_REGION
    string "VMA region for .dtb section"
    default "flash"

config DTB_LMA_REGION
    string "LMA region for .dtb section"
    default DTB_VMA_REGION

config DATA_VMA_REGION
    string "VMA region for .data section"
    default "ram"

config DATA_LMA_REGION
    string "LMA region for .data section"
    default "flash"

config BSS_VMA_REGION
    string "VMA region for .bss section"
    default "ram"

config BSS_LMA_REGION
    string "LMA region for .bss section"
    default "flash"

endmenu

config INITIAL_SP
    hex "Initial SP value"
```

## arch/armv7m/chip/Kconfig
```kconfig
# Chip selection configuration

choice
    prompt "Chip to target"
    default CHIP_STM32F40X

config CHIP_STM32F40X
    bool "stm32f40x"
    ---help---
        ST Microelectronics STM32F40x line of Cortex M4Fs.

config CHIP_LM4F120H5
    bool "lm4f120h5"
    ---help---
        Texas Instruments LM4F120H5 Cortex M4F.

config CHIP_MSP432P401X
    bool "msp432p401x"
    ---help---
        Texas Instruments MSP432P401x line of Cortex M4Fs.

endchoice

config CHIP
    string
    default "stm32f40x" if CHIP_STM32F40X
    default "lm4f120h5" if CHIP_LM4F120H5
    default "msp432p401x" if CHIP_MSP432P401X

config HAVE_FPU
    bool
    prompt "FPU Support"
    default y
    ---help---
        Enable support for ARMv7-M floating point extensions.

        Without this option enabled, executing floating point instructions
        will result in a usage fault.

        libgcc should be linked in to provide software floating point
        arithmetic routines.

config SHORT_DOUBLE
    bool
    prompt "Use short doubles"
    default y if HAVE_FPU
    ---help---
        Build with '-fshort-double'.

        This will make everything of the double type equivalent in size to
        that of the float type.  That means that doubles will only be single
        precision floating point values.  This is particularly useful for
        chips that contain only a single precision floating point unit, to
        ensure that the FPU is actually used for floating point arithmetic.

        Chips with an FPU that have not enabled this option will require libgcc
        to provide software routines for double precision floating point
        arithmetic.

config SYS_CLOCK
    int
    prompt "System clock speed"
    default 168000000 if CHIP_STM32F40X
    default 84000000 if CHIP_LM4F120H5
    default 48000000 if CHIP_MSP432P401X
    ---help---
        Note: This must be set to the value configured by the chip clock function

if CHIP_STM32F40X
source arch/armv7m/chip/stm32f40x/Kconfig
endif

if CHIP_LM4F120H5
source arch/armv7m/chip/lm4f120h5/Kconfig
endif

if CHIP_MSP432P401X
source arch/armv7m/chip/msp432p401x/Kconfig
endif
```

## arch/armv7m/chip/stm32f40x/Kconfig
```kconfig
config STM32_OSC_FREQ
    int
    default 8
    prompt "STM32 external crystal frequency"
    ---help---
        The oscillator frequency is important for configuring the system
        clock to 168MHz.  If set incorrectly, the chip may not boot properly.

choice
    prompt "Target board"
    default STM32_BOARD_STM32F4DISCOVERY

config STM32_BOARD_STM32F4DISCOVERY
    bool
    prompt "STM32F407 Discovery Board"

config STM32_BOARD_32F401CDISCOVERY
    bool
    prompt "STM32F401 Discovery Board"

config STM32_BOARD_PX4
    bool
    prompt "PX4 Autopilot"
endchoice

config STM32_BOARD
    string
    default "stm32f4discovery" if STM32_BOARD_STM32F4DISCOVERY
    default "32f401cdiscovery" if STM32_BOARD_32F401CDISCOVERY
    default "px4" if STM32_BOARD_PX4

config PERFCOUNTER
    bool
    default y
```

## chip/Kconfig
```kconfig
# Chip selection configuration

choice
    prompt "Chip to target"
    default CHIP_STM32F40X

config CHIP_STM32F40X
    bool "stm32f40x"
    ---help---
        ST Microelectronics STM32F40x line of Cortex M4Fs.

config CHIP_LM4F120H5
    bool "lm4f120h5"
    ---help---
        Texas Instruments LM4F120H5 Cortex M4F.

endchoice

config CHIP
    string
    default "stm32f40x" if CHIP_STM32F40X
    default "lm4f120h5" if CHIP_LM4F120H5

menu "Chip"
if CHIP_STM32F40X
source chip/stm32f40x/Kconfig
endif

if CHIP_LM4F120H5
source chip/lm4f120h5/Kconfig
endif
endmenu
```

## chip/stm32f40x/Kconfig
```kconfig
config STM32_OSC_FREQ
    int
    default 8
    prompt "STM32 external crystal frequency"
    ---help---
        The oscillator frequency is important for configuring the system
        clock to 168MHz.  If set incorrectly, the chip may not boot properly.

choice
    prompt "Target board"
    default STM32_BOARD_DISCOVERY

config STM32_BOARD_DISCOVERY
    bool
    prompt "STM32F407 Discovery Board"

config STM32_BOARD_PX4
    bool
    prompt "PX4 Autopilot"
endchoice

config STM32_BOARD
    string
    default "discovery" if STM32_BOARD_DISCOVERY
    default "px4" if STM32_BOARD_PX4

config DISCOVERY_LED
    bool
    depends on HAVE_LED
    default y if STM32_BOARD_DISCOVERY

config PERFCOUNTER
    bool
    default y

config PX4_LED
    bool
    depends on HAVE_LED
    default y if STM32_BOARD_PX4
```

## dev/Kconfig
```kconfig
config HAVE_USART
    bool
    prompt "(Legacy) USART Support"

config HAVE_I2C
    bool
    prompt "I2C Support"

config HAVE_SPI
    bool
    prompt "SPI Support"

config HAVE_LED
    bool
    prompt "LED Support"

config HAVE_USBDEV
    bool
    prompt "(Legacy) USB Device Support"

config STDOUT_DEV
    string "Standard output device"
    ---help---
        Device name of default stdout device; usually FDT path.  Must be
        castable to a char_device.

config STDERR_DEV
    string "Standard error device"
    ---help---
        Device name of default stderr device; usually FDT path.  Must be
        castable to a char_device.

config SYSTICK_FREQ
    int
    prompt "Systick Frequency"
    default 4000
    ---help---
        The frequency at which system ticks (and thus, task switching), should occur.

config SHARED_MEM_SIZE
    int
    prompt "Shared memory resource buffer size"
    default 512
    ---help---
        The size of buffer to be allocated for each shared memory
        resource opened.

config ADC_CLASS
    bool "ADC Support"
    default y
    ---help---
        Enable support for the ADC class and drivers.  The ADC drivers provide
        support for analog inputs, given a GPIO object.

config PWM_CLASS
    bool "PWM Support"
    default y
    ---help---
        Enable support for the PWM class and drivers.  The PWM drivers provide
        support for hardware and/or software PWM outputs, given a GPIO object.

config UART_CLASS
    bool "UART Support"
    default y
    ---help---
        Enable support for the UART class and drivers.  The UART drivers provide
        support for hardware and software UARTs.

source "dev/mpu6000/Kconfig"

config ACCELEROMETERS
    bool "Accelerometer support"
    ---help---
        Include support for accelerometers.

if ACCELEROMETERS
    source "dev/accel/Kconfig"
endif

config BAROMETERS
    bool "Barometer support"
    ---help---
        Include support for barometers.

if BAROMETERS
    source "dev/baro/Kconfig"
endif

config GYROSCOPES
    bool "Gyroscope support"
    ---help---
        Include support for gyroscopes.

if GYROSCOPES
    source "dev/gyro/Kconfig"
endif

config MAGNETOMETERS
    bool "Magnetometer support"
    ---help---
        Include support for magnetometers.

if MAGNETOMETERS
    source "dev/mag/Kconfig"
endif

config ROTARY_ENCODERS
    bool "Rotary encoder support"
    ---help---
        Include support for rotary encoders.

if ROTARY_ENCODERS
    source "dev/rotary_encoder/Kconfig"
endif
```

## dev/Kconfig.I2C
```kconfig
config 9DOF_GYRO
    bool "ITG-3200 Gyro"
    depends on HAVE_I2C && STM32_BOARD_DISCOVERY
    ---help---
        Gyroscope on Sparkfun 9DOF sensor stick, connected
        to I2C1 on the STM32F4 Discovery board

config HMC5883
    bool "Honeywell HMC5883 Magnetometer"
    depends on HAVE_I2C && STM32_BOARD_PX4
    ---help---
        Honeywell magnetometer on PX4 autopilot

config MS5611
    bool "Measurement Specialists MS5611 Barometer"
    depends on HAVE_I2C && STM32_BOARD_PX4
    ---help---
        Measurement Specialists barometer on PX4 autopilot
```

## dev/Kconfig.SPI
```kconfig
config DISCOVERY_ACCEL
    bool "STMicro LIS302DL Accelerometer"
    depends on HAVE_SPI && STM32_BOARD_DISCOVERY
    ---help---
        STMicro accelerometer on STM32F4 Discovery board

config MPU6000
    bool "InvenSense MPU6000 Gyro + Accelerometer"
    depends on HAVE_SPI && STM32_BOARD_PX4
    ---help---
        MPU6000 onboard PX4 autopilot
```

## dev/accel/Kconfig
```kconfig
menu "Accelerometers"

config MPU6000_ACCEL
    bool "InvenSense MPU6000 Accelerometer"
    depends on MPU6000
    ---help---
        MPU6000 accelerometer driver.  Provides access to the accelerometer
        features of the MPU6000, with a standard accelerometer driver.

config STM_LIS302DL
    bool "STMicro LIS302DL Accelerometer"
    depends on HAVE_SPI
    ---help---
        3-axis accelerometer from STMicro.  Configured with
        struct lis302dl_accel_config from board_config.h.

endmenu
```

## dev/baro/Kconfig
```kconfig
menu "Barometers"

config MS5611
    bool "Measurement Specialists MS5611 Barometer"
    depends on HAVE_I2C
    ---help---
    Standard barometer driver for MS5611.

endmenu
```

## dev/gyro/Kconfig
```kconfig
menu "Gyroscopes"

config MPU6000_GYRO
    bool "InvenSense MPU6000 Gyroscope"
    depends on MPU6000
    ---help---
        MPU6000 gyroscope driver.  Provides access to the gyroscope
        features of the MPU6000, with a standard gyroscope driver.

config ITG3200_GYRO
    bool "InvenSense ITG-3200 Gyroscope"
    depends on HAVE_I2C
    ---help---
        InvenSense ITG-3200 Gyroscope driver.  Configured with
        struct itg3200_gyro_config from board_config.h

endmenu
```

## dev/mag/Kconfig
```kconfig
menu "Magnetometers"

config HMC5883
    bool "Honeywell HMC5883 Magnetometer"
    depends on HAVE_I2C
    ---help---
        Standard magnetometer driver for HMC5883.

endmenu
```

## dev/mpu6000/Kconfig
```kconfig
config MPU6000
    bool "InvenSense MPU6000"
    depends on HAVE_SPI
    ---help---
        Base class for MPU6000 support.  Provides device-level support for the
        MPU6000, with support for reading/writing registers, allowing
        accelerometer and gyro drivers to be built on top.
```
