## kernel/Kconfig
```kconfig
config TASK_STACK_SIZE
    int
    prompt "Task stack size"
    default 255
    ---help---
        The stack size allocated to each task, in words.
        When building unoptimized, most tasks will need
        more stack space, so this will probably the limiting
        factor.  It is recommended to set this to a value
        2^n - 1 in order to limit wasted space in the memory
        allocator, which must allocate 2^n sized regions, and
        will set aside one word for a header.

config RESOURCE_TABLE_SIZE
    int
    prompt "Maximum number of resources per task"
    default 16
    ---help---
        The maximum number of resources any given task will
        be able to open at one time.

config HELD_SEMAPHORES_MAX
    int
    prompt "Maximum number of held semaphores per task"
    default 6
    ---help---
        The maximum number of semaphores any given task will
        be able to hold at one time.  Each held semaphore must
        be stored alongside the task to aid in deadlock checking.
```

## mm/Kconfig
```kconfig
choice
    prompt "Allocator type"
    default MM_ALLOCATOR_BUDDY

config MM_ALLOCATOR_BUDDY
    bool "Buddy allocator"
    ---help---
        Buddy allocator. Only power of two allocations are made,
        leading to esay merging of blocks. Internal fragmentation
        is high, but external fragmentation is low.

config MM_ALLOCATOR_BITFIELD
    bool "Bitfield allocator"
    ---help---
        Bitfield allocator. Allocation granularity down configurable.
        Harder to "merge" after smaller allocations, leading to small
        internal fragmentation but high external fragmentation.

endchoice

config SUSERHEAP
    hex
    default 0x20000000 if CHIP_STM32F40X
    default 0x20004000 if CHIP_LM4F120H5

config SKERNELHEAP
    hex
    default 0x10008000 if CHIP_STM32F40X
    default 0x20002000 if CHIP_LM4F120H5

config EUSERHEAP
    hex
    default 0x2001FFFC if CHIP_STM32F40X
    default 0x20008000 if CHIP_LM4F120H5

config EKERNELHEAP
    hex
    default 0x1000FFFC if CHIP_STM32F40X
    default 0x20004000 if CHIP_LM4F120H5

config MM_GRAIN_SHIFT
    int
    default 4
    depends on MM_ALLOCATOR_BITFIELD
    prompt "Bitfield allocator grain shift"
    ---help---
        Power of 2 for the bitfield allocator granularity.
        2**this is what it rounds up to when allocating space.

config MM_USER_MAX_ORDER
    int
    depends on MM_ALLOCATOR_BUDDY
    prompt "User buddy heap max order"
    default 17 if CHIP_STM32F40X
    default 14 if CHIP_LM4F120H5
    ---help---
        Maximum buddy block order for user buddy heap.
        Heap will be 2^order bytes.

config MM_USER_MIN_ORDER
    int
    depends on MM_ALLOCATOR_BUDDY
    prompt "User buddy heap min order"
    default 4
    ---help---
        Minimum buddy block order to allocate for user buddy.

config MM_KERNEL_MAX_ORDER
    int
    depends on MM_ALLOCATOR_BUDDY
    prompt "Kernel buddy heap max order"
    default 15 if CHIP_STM32F40X
    default 13 if CHIP_LM4F120H5
    ---help---
        Maximum buddy block order for kernel buddy heap.
        Heap will be 2^order bytes.

config MM_KERNEL_MIN_ORDER
    int
    depends on MM_ALLOCATOR_BUDDY
    prompt "Kernel buddy heap min order"
    default 4
    ---help---
        Minimum buddy block order to allocate for kernel buddy.

config MM_PROFILING
    bool
    depends on PERFCOUNTER
    prompt "Memory manager profiling"
    default n
    ---help---
        Enables instrumenting mm functions and using mem_perf
```
