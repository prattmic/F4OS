/include/ "01.dtsi"

/* STM32F401 with 64KiB SRAM and 256KiB flash */

/ {
    compatible = "stmicro,stm32f401xc", "stmicro,stm32f401", "stmicro,stm32f4";

    memory {
        compatible = "address-layout";
        #address-cells = <1>;
        #size-cells = <1>;

        /* 256 KiB flash */
        flash {
            attr = "rx";
            reg = <0x08000000 0x40000>;
        };

        /* 64 KiB SRAM */
        ram {
            attr = "rwx";
            reg = <0x20000000 0x10000>;
        };
    };
};
